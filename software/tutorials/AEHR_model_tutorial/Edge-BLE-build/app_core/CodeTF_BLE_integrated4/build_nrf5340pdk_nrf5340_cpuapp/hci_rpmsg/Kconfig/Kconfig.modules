## software/tutorials/AEHR_model_tutorial/Edge-BLE-build/app_core/CodeTF_BLE_integrated4/build_nrf5340pdk_nrf5340_cpuapp/hci_rpmsg/Kconfig/Kconfig.modules
```kconfig
osource "/home/devan/Documents/ncs/nrf/Kconfig.nrf"

osource "/home/devan/Documents/ncs/bootloader/mcuboot/zephyr/Kconfig"

osource "/home/devan/Documents/ncs/nrfxlib/Kconfig.nrfxlib"
```

## software/tutorials/AEHR_model_tutorial/Edge-BLE-build/net_core/hci_rpmsg/build_nrf5340pdk_nrf5340_cpunet/Kconfig/Kconfig.soc.arch
```kconfig
osource "/home/devan/Documents/ncs/zephyr/soc/$(ARCH)/Kconfig"
osource "/home/devan/Documents/ncs/zephyr/soc/$(ARCH)/*/Kconfig"
```
