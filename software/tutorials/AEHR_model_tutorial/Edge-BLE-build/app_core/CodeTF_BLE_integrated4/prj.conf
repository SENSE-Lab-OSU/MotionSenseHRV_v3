## CMakeLists.txt
```
# SPDX-License-Identifier: Apache-2.0

cmake_minimum_required(VERSION 3.13.1)
find_package(Zephyr HINTS $ENV{ZEPHYR_BASE})
project(external_lib)

#target_sources(app PRIVATE src/hello_world_test.cc)
target_sources(app PRIVATE src/main.cc)
target_sources(app PRIVATE src/main_functions.cc)
target_sources(app PRIVATE src/constants.cc)
target_sources(app PRIVATE src/output_handler.cc)
target_sources(app PRIVATE src/aencoder.cc)
target_sources(app PRIVATE src/assert.cc)
target_sources(app PRIVATE src/model.cc)
target_sources(app PRIVATE src/tensorFlowService.cc)
target_sources(app PRIVATE src/sample_test.cc)

zephyr_include_directories(src)

# The external static library that we are linking with does not know
# how to build for this platform so we export all the flags used in
# this zephyr build to the external build system.
#
# Other external build systems may be self-contained enough that they
# do not need any build information from zephyr. Or they may be
# incompatible with certain zephyr options and need them to be
# filtered out.

set(TARGET ${BOARD})
set(TARGET_ARCH cortex-m33)

#!!!ERROR!!!!                  # you need to fix the following path before you run the code
set(TF_SRC_DIR  /home/devan/Documents/ncs/nrf/applications/nrf-tensorflow/tensorflow)
#set(TF_SRC_DIR ${CMAKE_CURRENT_SOURCE_DIR}/../tensorflow)    #Somehow this does not work, and I have no idea why CMAKE does not like the relative path.
set(TF_MAKE_DIR ${TF_SRC_DIR}/tensorflow/lite/micro/tools/make)
set(TF_LIB_DIR ${TF_MAKE_DIR}/gen/${TARGET}_${TARGET_ARCH}/lib)
set(extra_project_flags "-mcpu=${TARGET_ARCH} -mthumb -mno-thumb-interwork -mhard-float -mfpu=fpv5-sp-d16") #I had to remove -DTF_LITE_STATIC_MEMORY to make hello_world run. 

zephyr_get_include_directories_for_lang_as_string(       C C_includes)
zephyr_get_system_include_directories_for_lang_as_string(C C_system_includes)
zephyr_get_compile_definitions_for_lang_as_string(       C C_definitions)
zephyr_get_compile_options_for_lang_as_string(           C C_options)

set(external_project_cflags
  "${C_includes} ${C_definitions} ${optC_optionsions} ${C_system_includes} ${extra_project_flags}"
)

zephyr_get_include_directories_for_lang_as_string(       CXX CXX_includes)
zephyr_get_system_include_directories_for_lang_as_string(CXX CXX_system_includes)
zephyr_get_compile_definitions_for_lang_as_string(       CXX CXX_definitions)
zephyr_get_compile_options_for_lang_as_string(           CXX CXX_options)

set(external_project_cxxflags
  "${CXX_includes} ${CXX_definitions} ${CXX_options} ${CXX_system_includes} ${extra_project_flags}"
)

include(ExternalProject)

# Add an external project to be able download and build the third
# party library. In this case downloading is not necessary as it has
# been committed to the repository.




if(CMAKE_GENERATOR STREQUAL "Unix Makefiles")
# https://www.gnu.org/software/make/manual/html_node/MAKE-Variable.html
set(submake "$(MAKE)")
else() # Obviously no MAKEFLAGS. Let's hope a "make" can be found somewhere.
set(submake "make")
endif()

ExternalProject_Add(
  tf_project                 # Name for custom target
  #PREFIX     ${mylib_build_dir} # Root dir for entire project
  SOURCE_DIR ${TF_SRC_DIR}
  BINARY_DIR ${TF_SRC_DIR} # This particular build system is invoked from the root
  CONFIGURE_COMMAND ""    # Skip configuring the project, e.g. with autoconf
  BUILD_COMMAND
  ${submake} -f tensorflow/lite/micro/tools/make/Makefile
  TARGET=${TARGET}
  TARGET_ARCH=${TARGET_ARCH}
  TARGET_TOOLCHAIN_ROOT=${GNUARMEMB_TOOLCHAIN_PATH}/bin/
  TARGET_TOOLCHAIN_PREFIX=arm-none-eabi-
  #PREFIX=${mylib_build_dir}
  CC=${CMAKE_C_COMPILER}
  CXX=${CMAKE_CXX_COMPILER}
  AR=${CMAKE_AR}
  CCFLAGS=${external_project_cflags} 
  CXXFLAGS=${external_project_cxxflags} 
  microlite
  INSTALL_COMMAND ""      # This particular build system has no install command
  BUILD_BYPRODUCTS home/devan/Documents/libtensorflow-microlite.a
  )

# Create a wrapper CMake library that our app can link with
add_library(tf_lib STATIC IMPORTED GLOBAL)

add_dependencies(
  tf_lib
  tf_project
  )
set_target_properties(tf_lib PROPERTIES IMPORTED_LOCATION             ${TF_LIB_DIR}/libtensorflow-microlite.a)
set_target_properties(tf_lib PROPERTIES INTERFACE_INCLUDE_DIRECTORIES "${TF_SRC_DIR};${TF_SRC_DIR}/tensorflow/lite/micro;${TF_MAKE_DIR}/downloads/flatbuffers/include") 

target_link_libraries(app PUBLIC tf_lib)
```

## prj.conf
```kconfig
CONFIG_NCS_SAMPLES_DEFAULTS=y

CONFIG_STDOUT_CONSOLE=y
CONFIG_CPLUSPLUS=y
CONFIG_STD_CPP11=y
CONFIG_NEWLIB_LIBC=y
CONFIG_LIB_CPLUSPLUS=y

#FPU config
CONFIG_FPU=y
CONFIG_FP_HARDABI=y



CONFIG_PRINTK=y

# Library for buttons and LEDs
CONFIG_DK_LIBRARY=y

# Enable bluetooth and bonding
CONFIG_BT_SETTINGS=y
CONFIG_BT=y
CONFIG_BT_BONDABLE=y
CONFIG_BT_BONDING_REQUIRED=y
CONFIG_BT_DEBUG_LOG=y
CONFIG_BT_DEVICE_APPEARANCE=833
CONFIG_BT_GAP_PERIPHERAL_PREF_PARAMS=y
CONFIG_BT_MAX_CONN=1
CONFIG_BT_L2CAP_TX_BUF_COUNT=12
CONFIG_BT_PERIPHERAL=y
CONFIG_BT_PERIPHERAL_PREF_MAX_INT=10
CONFIG_BT_PERIPHERAL_PREF_MIN_INT=6
CONFIG_BT_PERIPHERAL_PREF_TIMEOUT=100
CONFIG_BT_DEVICE_NAME="MotionSenseHRV3"
CONFIG_BT_CTLR_CONN_PARAM_REQ=y
CONFIG_BT_SMP=y

# ENABLE device information service
CONFIG_BT_DIS=y
CONFIG_BT_DIS_FW_REV=y
CONFIG_BT_DIS_FW_REV_STR="1.0"
CONFIG_BT_DIS_HW_REV=y
CONFIG_BT_DIS_HW_REV_STR="1.0"
CONFIG_BT_DIS_MANUF="EETech"
CONFIG_BT_DIS_PNP=n
CONFIG_BT_DIS_MODEL="TensorFlowEn"
CONFIG_BT_DIS_SETTINGS=y
CONFIG_BT_MAX_PAIRED=1

# Enable Battery settings
CONFIG_BT_BAS=y

# SOftdevice configuration
CONFIG_BT_LL_SOFTDEVICE_DEFAULT=y


CONFIG_SETTINGS_RUNTIME=y
CONFIG_SETTINGS=y
CONFIG_SETTINGS_NONE=y
CONFIG_FLASH=y
CONFIG_FLASH_PAGE_LAYOUT=y
CONFIG_FLASH_MAP=y
CONFIG_NVS=y

# timer config
CONFIG_NRFX_TIMER=y
CONFIG_NRFX_TIMER1=y
CONFIG_NRFX_TIMER0=y
CONFIG_NRFX_TIMER2=y

CONFIG_SYSTEM_WORKQUEUE_STACK_SIZE=8192
CONFIG_HEAP_MEM_POOL_SIZE=16384
CONFIG_MAIN_STACK_SIZE=8192
```

## src/main.cc
```c
/* Copyright 2019 The TensorFlow Authors. All Rights Reserved.

Licensed under the Apache License, Version 2.0 (the "License");
you may not use this file except in compliance with the License.
You may obtain a copy of the License at

    http://www.apache.org/licenses/LICENSE-2.0

Unless required by applicable law or agreed to in writing, software
distributed under the License is distributed on an "AS IS" BASIS,
WITHOUT WARRANTIES OR CONDITIONS OF ANY KIND, either express or implied.
See the License for the specific language governing permissions and
limitations under the License.
==============================================================================*/

#include "main_functions.h"

#include <zephyr.h>
#include <zephyr/types.h>
#include <stddef.h>
#include <string.h>
#include <errno.h>
#include <sys/printk.h>
#include <sys/byteorder.h>
#include <drivers/gpio.h>
#include <soc.h>
#include <kernel.h>
#include "common.h"
#include <bluetooth/bluetooth.h>
#include <bluetooth/hci.h>
#include <bluetooth/conn.h>
#include <bluetooth/uuid.h>
#include <bluetooth/gatt.h>

#include "battery_service.h" 
#include <settings/settings.h>
#include "tensorFlowService.h"
#include <nrfx_timer.h>
#include <dk_buttons_and_leds.h>

#define DEVICE_NAME             CONFIG_BT_DEVICE_NAME
#define DEVICE_NAME_LEN         (sizeof(DEVICE_NAME) - 1)

#define DIS_FW_REV_STR		 CONFIG_BT_DIS_FW_REV_STR
#define DIS_FW_REV_STR_LEN 	 (sizeof(DIS_FW_REV_STR))

#define DIS_HW_REV_STR 	 CONFIG_BT_DIS_HW_REV_STR
#define DIS_HW_REV_STR_LEN 	 (sizeof(DIS_HW_REV_STR))

#define DIS_MANUF		 CONFIG_BT_DIS_MANUF
#define DIS_MANUF_LEN 	 	 (sizeof(DIS_MANUF))

#define DIS_MODEL		 CONFIG_BT_DIS_MODEL
#define DIS_MODEL_LEN		 (sizeof(DIS_MODEL))

#define TIMER_MS 4
#define TIMER_PRIORITY 0
#define WORKQUEUE_STACK_SIZE 512
#define WORKQUEUE_PRIORITY -3
#define TFMICRO_DATA_LEN 3
#define RUN_STATUS_LED          DK_LED1

K_THREAD_STACK_DEFINE(my_stack_area, WORKQUEUE_STACK_SIZE);
struct batteryInfo my_device;
struct TfMicroInfo my_service;
struct k_work_q my_work_q;

void timer_handler(nrf_timer_event_t, void*);

static K_SEM_DEFINE(ble_init_ok, 0, 1);

uint16_t global_counter;

static bool connectedFlag=false;
static const struct bt_data ad[] = {
	BT_DATA_BYTES(BT_DATA_FLAGS, (BT_LE_AD_GENERAL | BT_LE_AD_NO_BREDR)),
	BT_DATA(BT_DATA_NAME_COMPLETE, DEVICE_NAME, DEVICE_NAME_LEN),
};

static const struct bt_data sd[] = {
	BT_DATA_BYTES(BT_DATA_UUID128_ALL, TFMICRO_SERVICE_UUID),
};

struct bt_conn *my_connection;

static const nrfx_timer_t timer_global = NRFX_TIMER_INSTANCE(1); // Using TIMER1 as TIMER 0 is used by RTOS for ble


static uint8_t ii =0;

// Setting up the device information service
static int settings_runtime_load(void)
{
	settings_runtime_set("bt/dis/model",
			     DIS_MODEL,
			     DIS_MODEL_LEN);
	settings_runtime_set("bt/dis/manuf",
			     DIS_MANUF,
			     DIS_MANUF_LEN);


	settings_runtime_set("bt/dis/fw",
			     DIS_FW_REV_STR,
			     DIS_FW_REV_STR_LEN);
	settings_runtime_set("bt/dis/hw",
			     DIS_HW_REV_STR,
			     DIS_HW_REV_STR_LEN);
	return 0;
}

static void timer_deinit(void)
{
	nrfx_timer_disable(&timer_global);
    	nrfx_timer_uninit(&timer_global);	
}


static void timer_init(void)
{
	uint32_t time_ticks;
	nrfx_err_t          err;
	nrfx_timer_config_t timer_cfg = {
		.frequency = NRF_TIMER_FREQ_1MHz,
		.mode      = NRF_TIMER_MODE_TIMER,
		.bit_width = NRF_TIMER_BIT_WIDTH_24,
		.interrupt_priority = TIMER_PRIORITY,
		.p_context = NULL,
	};  

	err = nrfx_timer_init(&timer_global, &timer_cfg, timer_handler);
	if (err != NRFX_SUCCESS) {
		printk("nrfx_timer_init failed with: %d\n", err);
	}
	else
		printk("nrfx_timer_init success with: %d\n", err);
	time_ticks = nrfx_timer_ms_to_ticks(&timer_global, TIMER_MS);
	printk("time ticks = %d\n", time_ticks);


    	nrfx_timer_extended_compare(&timer_global, NRF_TIMER_CC_CHANNEL0, time_ticks \ 
         , NRF_TIMER_SHORT_COMPARE0_CLEAR_MASK, true);

    	nrfx_timer_enable(&timer_global);
}


static void connected(struct bt_conn *conn, uint8_t err)
{
	struct bt_conn_info info; 
	char addr[BT_ADDR_LE_STR_LEN];

	my_connection = conn;

	if (err) 
	{
		printk("Connection failed (err %u)\n", err);
		return;
	}
	else if(bt_conn_get_info(conn, &info))
	{
		printk("Could not parse connection info\n");
	}
	else
	{  // Start the timer and stop advertising and initialize all the modules
		bt_addr_le_to_str(bt_conn_get_dst(conn), addr, sizeof(addr));
		
		printk("Connection established!		\n\
		Connected to: %s					\n\
		Role: %u							\n\
		Connection interval: %u				\n\
		Slave latency: %u					\n\
		Connection supervisory timeout: %u	\n"
		, addr, info.role, info.le.interval, info.le.latency, info.le.timeout);
		
		tfMicro_service_init();
  		IRQ_CONNECT(TIMER1_IRQn, TIMER_PRIORITY,
			nrfx_timer_1_irq_handler, NULL, 0);
               connectedFlag=true;
		timer_init();
		global_counter = 0;
	}

}

static void disconnected(struct bt_conn *conn, uint8_t reason)
{
	// Stop timer and do all the cleanup
	printk("Disconnected (reason %u)\n", reason);
	timer_deinit();	
	connectedFlag=false;
}

static bool le_param_req(struct bt_conn *conn, struct bt_le_conn_param *param)
{
	
	//If acceptable params, return true, otherwise return false.
	if((param->interval_min > 9) && (param->interval_max > 10))
		return false;
	else
		return true; 
}

static void le_param_updated(struct bt_conn *conn, uint16_t interval, uint16_t latency, uint16_t timeout)
{
	struct bt_conn_info info; 
	char addr[BT_ADDR_LE_STR_LEN];
	
	if(bt_conn_get_info(conn, &info))
	{
		printk("Could not parse connection info\n");
	}
	else
	{
		bt_addr_le_to_str(bt_conn_get_dst(conn), addr, sizeof(addr));
		
		printk("Connection parameters updated!	\n\
		Connected to: %s						\n\
		New Connection Interval: %u				\n\
		New Slave Latency: %u					\n\
		New Connection Supervisory Timeout: %u	\n"
		, addr, info.le.interval, info.le.latency, info.le.timeout);
	}
}

static struct bt_conn_cb conn_callbacks = 
{
	.connected			= connected,
	.disconnected   		= disconnected,
	.le_param_req			= le_param_req,
	.le_param_updated		= le_param_updated
};
static void error(void)
{
	while (true) {
		printk("Error!\n");
		/* Spin for ever */
		k_sleep(K_MSEC(1000)); //1000ms
	}
}

static void bt_ready(int err)
{
	if (err) 
	{
		printk("BLE init failed with error code %d\n", err);
		return;
	}
	else 	
		printk("BLE init success\n");
	
       
	settings_load();
	 
	settings_runtime_load();

	//Configure connection callbacks
	bt_conn_cb_register(&conn_callbacks);

	//Initalize services
	err = tfMicro_service_init();
        
	if (err) 
	{
		printk("Failed to init tf Micro (err:%d)\n", err);
		return;
	}

	//Start advertising
	const struct bt_le_adv_param v={ \
        .id = BT_ID_DEFAULT, \
        .sid = 0, \
        .secondary_max_skip = 0, \
        .options = BT_LE_ADV_OPT_CONNECTABLE,\
        .interval_min = BT_GAP_ADV_FAST_INT_MIN_2, \
        .interval_max = BT_GAP_ADV_FAST_INT_MAX_2, \
        .peer = NULL
	};
	
        err = bt_le_adv_start(&v, ad, ARRAY_SIZE(ad),
			      sd, ARRAY_SIZE(sd));
	if (err) {
		printk("Advertising failed to start (err %d)\n", err);

	}
       else
       printk("Advertising successfully started\n");

	k_sem_give(&ble_init_ok);
}

// Initialize BLE
static void ble_init(void)
{
	int err;
	


	err = bt_enable(bt_ready);
	if (err) 
	{
		printk("BLE initialization failed\n");
		error(); //Catch error
	}
	
	err = k_sem_take(&ble_init_ok, K_MSEC(500));

	if (!err) 
	{
		printk("Bluetooth initialized\n");
	} else 
	{
		printk("BLE initialization did not complete in time\n");
		error(); //Catch error
	}
	if (err) {
		printk("Bluetooth init failed (err %d)\n", err);
		
	}	
}

// Timer handler that periodically executes commands with a period, 
// which is defined by the macro-variable TIMER_MS

void timer_handler(nrf_timer_event_t event_type, void* p_context)
{

    switch (event_type)
    {
    	uint8_t new_period;
    	uint8_t dataPacket[TFMICRO_DATA_LEN]; // Data packet sent in the TF lite service, contains 3 Bytes 
    	
        case NRF_TIMER_EVENT_COMPARE0:
        	global_counter++; // Packet counter 
        	
        	if(global_counter % 500 ==0) { // Executes every 2 seconds
        		ii++;
			//printk("Counter=%d\n",ii);
			my_device.battery_value=ii;
			k_work_submit(&my_device.work); // Schedule a work in the workqueue to notify battery level
        	}
        	
        	if(global_counter % 500 ==0) { // Executes every 40 ms
        	   	new_period = loop();
        	    	dataPacket[0] = (uint8_t)new_period;
        	    	dataPacket[1] = (uint8_t)((global_counter& 0xFF00)>>8);
        	    	dataPacket[2] = (uint8_t)((global_counter& 0x00FF));        	    
		    	my_service.dataPacket = dataPacket;
		    	my_service.packetLength = sizeof(dataPacket);
		    	//printk("global counter=%u,size=%u\n",global_counter,sizeof(dataPacket));
                        printk("sumbit value: %d", dataPacket[0]);
		    	k_work_submit(&my_service.work); // Schedule a work in the workqueue to send TF lite data
        	}    
	        
           break;

        default:
            //Do nothing.
            break;
    }
}



// This is the default main used on systems that have the standard C entry
// point. Other devices (for example FreeRTOS or ESP32) that have different
// requirements for entry code (like an app_main function) should specialize
// this main.cc file in a target-specific subfolder.
int main(int argc, char* argv[]) {
  int blink_status = 0;	
  setup();
 
  // Setup the LEDs for blinking while advertising	
  if (dk_leds_init()) {
		printk("LEDs init failed\n");
		
	}
  // Setup the workqueue thread 
  k_work_q_start(&my_work_q, my_stack_area,
               K_THREAD_STACK_SIZEOF(my_stack_area), WORKQUEUE_PRIORITY);
               
  k_work_init(&my_device.work, bas_notify);             // associate Battery service with a qorkqueue  
  k_work_init(&my_service.work, tfMicro_notify);        // associate tensorflow service with another workqueue     
  
               
  ble_init();	// Initialize BLE
  tfMicro_service_init(); // Initaalize array for TF service
  while (true) {

      k_sleep(K_MSEC(1000));
      if(!connectedFlag) // blink LED when the device is not connected and is in advertising state
      	dk_set_led(RUN_STATUS_LED, (++blink_status) % 2);
      else
      	dk_set_led(RUN_STATUS_LED, 0);  // Do not blink if  the device is connected

  }
}
```

## src/battery_service.h
```c
#include <zephyr.h>
#include <zephyr/types.h>
#include <sys/printk.h>
#include <device.h>
#include <drivers/pwm.h>
#include <bluetooth/bluetooth.h>
#include <bluetooth/hci.h>
#include <bluetooth/conn.h>
#include <bluetooth/uuid.h>
#include <bluetooth/gatt.h>
#include <kernel.h>
#include <bluetooth/services/lbs.h>
#include <bluetooth/services/bas.h>
#include <settings/settings.h>
#include "common.h"

struct batteryInfo {
    struct k_work work;
    uint8_t battery_value; // user-defined value to pass as input to the work-queue
}; // work queue structure used to execute Batter level notification in a interrupt service handler initiated by a timer. 
extern struct batteryInfo my_device ;  // work-queue instance for batter level

static void bas_notify(struct k_work *);
static void battery_config(void)
{
	// Code for configuring the battery monitor chip to be called in the initalization
}

// Function that periodically extracts the battery level and needs to be called in a timer routine 
static void bas_notify(struct k_work *item)
{
    	struct batteryInfo* the_device=  ((struct batteryInfo *)(((char *)(item)) - offsetof(struct batteryInfo, work)));
        	
    	//printk("Battery value =%u\n", the_device->battery_value);
	uint8_t battery_level = the_device->battery_value;

	bt_bas_set_battery_level(battery_level);
}
```

## src/common.h
```c
// printer.h file
#ifndef COMMON_H_
#define COMMON_H_

 // common.h code goes here
extern struct bt_conn *my_connection; // BLE conection instance used to access the  sofr-device controller
extern uint16_t global_counter;
#endif
```

## src/main_functions.cc
```c
/* Copyright 2020 The TensorFlow Authors. All Rights Reserved.

Licensed under the Apache License, Version 2.0 (the "License");
you may not use this file except in compliance with the License.
You may obtain a copy of the License at

    http://www.apache.org/licenses/LICENSE-2.0

Unless required by applicable law or agreed to in writing, software
distributed under the License is distributed on an "AS IS" BASIS,
WITHOUT WARRANTIES OR CONDITIONS OF ANY KIND, either express or implied.
See the License for the specific language governing permissions and
limitations under the License.
==============================================================================*/

#define USENEWMODEL 0

#include "main_functions.h"
#include "tensorflow/lite/micro/all_ops_resolver.h"
#include "constants.h"
#include "output_handler.h"
#include "tensorflow/lite/micro/micro_error_reporter.h"
#include "tensorflow/lite/micro/micro_interpreter.h"
#include "tensorflow/lite/schema/schema_generated.h"
#include "tensorflow/lite/version.h"

#if USENEWMODEL == 1
#include "aencoder.h"
#define MODEL_LEN 123904
#define MODEL_HEADROOM 200000
#define g_modelurd 0
#else
#include "model.h"
#define MODEL_LEN 2512
#define MODEL_HEADROOM 676
#define g_modelurd2 0
#endif

#include <zephyr.h>

// Globals, used for compatibility with Arduino-style sketches.
namespace
{
tflite::ErrorReporter *error_reporter = nullptr;
const tflite::Model *model = nullptr;
tflite::MicroInterpreter *interpreter = nullptr;
TfLiteTensor *input = nullptr;
TfLiteTensor *output = nullptr;
int inference_count = 0;

// Create an area of memory to use for input, output, and intermediate arrays.
// Minimum arena size, at the time of writing. After allocating tensors
// you can retrieve this value by invoking interpreter.arena_used_bytes().
const int kModelArenaSize = MODEL_LEN;
// Extra headroom for model + alignment + future interpreter changes.
const int kExtraArenaSize = MODEL_HEADROOM;
const int kTensorArenaSize = kModelArenaSize + kExtraArenaSize;
static uint8_t tensor_arena[kTensorArenaSize];
} // namespace

// The name of this function is important for Arduino compatibility.
void setup()
{
	outputInit();

	// Set up logging. Google style is to avoid globals or statics because of
	// lifetime uncertainty, but since this has a trivial destructor it's okay.
	// NOLINTNEXTLINE(runtime-global-variables)

	static tflite::MicroErrorReporter micro_error_reporter;
	error_reporter = &micro_error_reporter;

	// Map the model into a usable data structure. This doesn't involve any
	// copying or parsing, it's a very lightweight operation.
	if (USENEWMODEL){
            model = tflite::GetModel(g_modelurd2);
            }
        else {
            model = tflite::GetModel(g_modelurd);
            }

	if (model->version() != TFLITE_SCHEMA_VERSION) {
		TF_LITE_REPORT_ERROR(
			error_reporter,
			"Model provided is schema version %d not equal "
			"to supported version %d.",
			model->version(), TFLITE_SCHEMA_VERSION);
		return;
	}

	// This pulls in all the operation implementations we need.
	// NOLINTNEXTLINE(runtime-global-variables)
	static tflite::AllOpsResolver resolver;

	// Build an interpreter to run the model with.
	static tflite::MicroInterpreter static_interpreter(model, resolver,
							   tensor_arena,
							   kTensorArenaSize,
							   error_reporter);
	interpreter = &static_interpreter;

	// Allocate memory from the tensor_arena for the model's tensors.
	TfLiteStatus allocate_status = interpreter->AllocateTensors();

	if (allocate_status != kTfLiteOk) {
		TF_LITE_REPORT_ERROR(error_reporter,
				     "AllocateTensors() failed");

		return;
	}

	// Obtain pointers to the model's input and output tensors.
	input = interpreter->input(0);
	output = interpreter->output(0);

	// Keep track of how many inferences we have performed.
	inference_count = 0;
}

// The name of this function is important for Arduino compatibility.
unsigned int loop()
{
	// Calculate an x value to feed into the model. We compare the current
	// inference_count to the number of inferences per cycle to determine
	// our position within the range of possible x values the model was
	// trained on, and use this to calculate a value.
	float position = static_cast<float>(inference_count) /
			 static_cast<float>(kInferencesPerCycle);
	unsigned int output_tf;
	float x_val = position * kXrange;

	// Place our calculated x value in the model's input tensor
	input->data.f[0] = x_val;
	// Run inference, and report any error
	TfLiteStatus invoke_status = interpreter->Invoke();
	if (invoke_status != kTfLiteOk) {
		TF_LITE_REPORT_ERROR(error_reporter,
				     "Invoke failed on x_val: %f\n",
				     static_cast<double>(x_val));
		return NULL;
	}

	// Read the predicted y value from the model's output tensor
	float y_val = output->data.f[0];

	// Output the results. A custom HandleOutput function can be implemented
	// for each supported hardware target.
	output_tf = HandleOutput(error_reporter, x_val, y_val);


	// Increment the inference_counter, and reset it if we have reached
	// the total number per cycle
	inference_count += 1;
	if (inference_count >= kInferencesPerCycle){
		inference_count = 0;
        }
        int ren = 9;
        //we just have a random test variable here to see if bluetooth is sending
        printk("return value from from function: %d", ren);
	return ren;	
}
  
```

## src/main_functions2.cc
```c
/* Copyright 2020 The TensorFlow Authors. All Rights Reserved.

Licensed under the Apache License, Version 2.0 (the "License");
you may not use this file except in compliance with the License.
You may obtain a copy of the License at

    http://www.apache.org/licenses/LICENSE-2.0

Unless required by applicable law or agreed to in writing, software
distributed under the License is distributed on an "AS IS" BASIS,
WITHOUT WARRANTIES OR CONDITIONS OF ANY KIND, either express or implied.
See the License for the specific language governing permissions and
limitations under the License.
==============================================================================*/

//define target model to use
#define USENEWMODEL 0

#include "main_functions.h"

#include "tensorflow/lite/micro/all_ops_resolver.h"
#include "constants.h"

#include "output_handler.h"
#include "tensorflow/lite/micro/micro_error_reporter.h"
#include "tensorflow/lite/micro/micro_interpreter.h"
#include "tensorflow/lite/schema/schema_generated.h"
#include "tensorflow/lite/version.h"

#include "sample_test.cc"


#if USENEWMODEL == 1
#include "aencoder.h"
#define MODEL_LEN 123904
#define MODEL_HEADROOM 200000
#define g_modelurd 0
#else
#include "model.h"
#define MODEL_LEN 2512
#define MODEL_HEADROOM 676
#define g_modelurd2 0
#endif

#include <zephyr.h>

// Globals, used for compatibility with Arduino-style sketches.
namespace
{
tflite::ErrorReporter *error_reporter = nullptr;
const tflite::Model *model = nullptr;
tflite::MicroInterpreter *interpreter = nullptr;
TfLiteTensor *input = nullptr;
TfLiteTensor *output = nullptr;
int inference_count = 0;

// Create an area of memory to use for input, output, and intermediate arrays.
// Minimum arena size, at the time of writing. After allocating tensors
// you can retrieve this value by invoking interpreter.arena_used_bytes().
const int kModelArenaSize = MODEL_LEN;
// Extra headroom for model + alignment + future interpreter changes.
const int kExtraArenaSize = MODEL_HEADROOM;
const int kTensorArenaSize = kModelArenaSize + kExtraArenaSize;
static uint8_t tensor_arena[kTensorArenaSize];
} // namespace

// The name of this function is important for Arduino compatibility.
void setup()
{
	outputInit();

	// Set up logging. Google style is to avoid globals or statics because of
	// lifetime uncertainty, but since this has a trivial destructor it's okay.
	// NOLINTNEXTLINE(runtime-global-variables)

	static tflite::MicroErrorReporter micro_error_reporter;
	error_reporter = &micro_error_reporter;

	// Map the model into a usable data structure. This doesn't involve any
	// copying or parsing, it's a very lightweight operation.
        if (USENEWMODEL){
            model = tflite::GetModel(g_modelurd2);
            }
        else {
            model = tflite::GetModel(g_modelurd);
            }


	if (model->version() != TFLITE_SCHEMA_VERSION) {
		TF_LITE_REPORT_ERROR(
			error_reporter,
			"Model provided is schema version %d not equal "
			"to supported version %d.",
			model->version(), TFLITE_SCHEMA_VERSION);
		return;
	}

/* This pulls in all the operation implementations we need. However we might change
       this later on as we only really need dense and convulution functions for the autoencoder
       But, if we want models to be able to be swapped out during runtime, it should stay this way.*/

	// NOLINTNEXTLINE(runtime-global-variables)
	static tflite::AllOpsResolver resolver;

	// Build an interpreter to run the model with.
	static tflite::MicroInterpreter static_interpreter(model, resolver,
							   tensor_arena,
							   kTensorArenaSize,
							   error_reporter);
	interpreter = &static_interpreter;

	// Allocate memory from the tensor_arena for the model's tensors.
	TfLiteStatus allocate_status = interpreter->AllocateTensors();

	if (allocate_status != kTfLiteOk) {
		TF_LITE_REPORT_ERROR(error_reporter,
				     "AllocateTensors() failed");

		return;
	}

	// Obtain pointers to the model's input and output tensors.
	input = interpreter->input(0);
	output = interpreter->output(0);

	// Keep track of how many inferences we have performed.
	inference_count = 0;
}

// The name of this function is important for Arduino compatibility.
unsigned int loop()
{
        //first set our output array
        static float arr_result[16];

	//get a ppg sample to feed into the model. We this is an 8 second
	// sample for a total of 400 values, whitch should be placed in our input.
	

        TfLiteIntArray* n_dims = input->dims;
	// Place the calculated ppg value in the model's input tensor

        /*.f is not actually the floating point cast, it is a a structure member
        since it is a union, each of the . data types represents any possible input format.
        This could mean you could represent your input in uint8, or float32. We use
        float32 since that is the default specification for inputs and outputs in 
        tensorflow lite models.
        */

	float xval = 0;
        //get ready to load the test ppg data into the input tensor
        for (int i = 0; i<400; i++){
                xval = sample_data[i];
                input->data.f[i] = sample_data[i];
        }
        //just using this test variable to inspect whether everything checks out
        float test_bounds = input->data.f[399];



	//Now we run inference, and report any error
	TfLiteStatus invoke_status = interpreter->Invoke();
	if (invoke_status != kTfLiteOk) {
		TF_LITE_REPORT_ERROR(error_reporter,"Invoke failed");
				    
		return NULL;
	}

	// Read the predicted y value from the model's output tensor
	

	// Output the results. A custom HandleOutput function can be implemented
	// for each supported hardware target.

        
        for (int i = 0; i < 16; i++){
            arr_result[i] = output->data.f[i];
            }
        float y_1 = output->data.f[0];
        float y_2 = output->data.f[1];
        float y_16 = output->data.f[15];
	// Increment the inference_counter, and reset it if we have reached
	// the total number per cycle
	inference_count += 1;
        if (inference_count > 2000){
            inference_count = 0;
                       }
        int te = inference_count;
        printk("value returned, %d", te);
        //we return something random here since this is just to check to make sure ble is working.
	return te;	
}
  
```

## src/output_handler.cc
```c
/* Copyright 2019 The TensorFlow Authors. All Rights Reserved.

Licensed under the Apache License, Version 2.0 (the "License");
you may not use this file except in compliance with the License.
You may obtain a copy of the License at

    http://www.apache.org/licenses/LICENSE-2.0

Unless required by applicable law or agreed to in writing, software
distributed under the License is distributed on an "AS IS" BASIS,
WITHOUT WARRANTIES OR CONDITIONS OF ANY KIND, either express or implied.
See the License for the specific language governing permissions and
limitations under the License.
==============================================================================*/

#include "output_handler.h"

#include <zephyr.h>
#include <zephyr/types.h>
#include <sys/printk.h>
#include <device.h>
//#include <drivers/pwm.h>
#include <settings/settings.h>
#include <bluetooth/bluetooth.h>
#include <bluetooth/hci.h>
#include <bluetooth/conn.h>
#include <bluetooth/uuid.h>
#include <bluetooth/gatt.h>
#include "common.h"





#define MIN_PERIOD_USEC (USEC_PER_SEC / 64U)


static unsigned int period;
static unsigned int new_period;

void outputInit()
{

	period = MIN_PERIOD_USEC;
}


unsigned int HandleOutput(tflite::ErrorReporter *error_reporter, float x_value,
		  float y_value)
{
new_period = (unsigned int)((period * (y_value + 1) )/2);
    if( new_period >= period){
        new_period = period;
    } 
    
	
	// Log the current X and Y values

   // pwm_pin_set_usec(pwm, PWM_CHANNEL, period, new_period , PWM_FLAGS);
 	 /* TF_LITE_REPORT_ERROR(error_reporter, "x_value: %f, y_value: %f\n",
			     static_cast<double>(x_value),
			     static_cast<double>(y_value));  */ 
return new_period;
}
```

## src/sample_test.h
```c
extern const float sample_data[400];
```

## src/tensorFlowService.cc
```c
#include <zephyr/types.h>
#include <stddef.h>
#include <string.h>
#include <errno.h>
#include <sys/printk.h>
#include <sys/byteorder.h>
#include <zephyr.h>
#include <soc.h>

#include <bluetooth/bluetooth.h>
#include <bluetooth/hci.h>
#include <bluetooth/conn.h>
#include <bluetooth/uuid.h>
#include <bluetooth/addr.h>
#include <bluetooth/gatt.h>

#include "tensorFlowService.h"


static struct bt_uuid_128 bt_uuid_tfmicro = BT_UUID_INIT_128(TFMICRO_SERVICE_UUID);
static struct bt_uuid_128 bt_uuid_tfmicro_rx = BT_UUID_INIT_128(RX_CHARACTERISTIC_UUID);
static struct bt_uuid_128 bt_uuid_tfmicro_tx = BT_UUID_INIT_128(TX_CHARACTERISTIC_UUID);



#define BT_UUID_TFMICRO_SERVICE      (struct bt_uuid *)(&bt_uuid_tfmicro)
#define BT_UUID_TFMICRO_SERVICE_RX   (struct bt_uuid *)(&bt_uuid_tfmicro_rx)
#define BT_UUID_TFMICRO_SERVICE_TX   (struct bt_uuid *)(&bt_uuid_tfmicro_tx)

#define MAX_TRANSMIT_SIZE 240//TODO figure this out

uint8_t data_rx[MAX_TRANSMIT_SIZE];
uint8_t data_tx[MAX_TRANSMIT_SIZE];

int tfMicro_service_init(void)
{
    int err = 0;

    memset(&data_rx, 0, MAX_TRANSMIT_SIZE);
    memset(&data_tx, 0, MAX_TRANSMIT_SIZE);

    return err;
}

/* This function is called whenever the RX Characteristic has been written to by a Client */
static ssize_t on_receive(struct bt_conn *conn,
			  const struct bt_gatt_attr *attr,
			  const void *buf,
			  uint16_t len,
			  uint16_t offset,
			  uint8_t flags)
{
    const uint8_t * buffer =(const uint8_t*) buf;
    
	printk("Received data, handle %d, conn %p, data: 0x", attr->handle, conn);
    for(uint8_t i = 0; i < len; i++){
        printk("%02X", buffer[i]);
    }
    printk("\n");

	return len;
}

/* This function is called whenever a Notification has been sent by the TX Characteristic */
static void on_sent(struct bt_conn *conn, void *user_data)
{
	ARG_UNUSED(user_data);

    const bt_addr_le_t * addr = bt_conn_get_dst(conn);
    /*    
	printk("Data sent to Address 0x %02X %02X %02X %02X %02X %02X \n", addr->a.val[0]
                                                                    , addr->a.val[1]
                                                                    , addr->a.val[2]
                                                                    , addr->a.val[3]
                                                                    , addr->a.val[4]
                                                                    , addr->a.val[5]);*/
}

/* This function is called whenever the CCCD register has been changed by the client*/
void on_cccd_changed(const struct bt_gatt_attr *attr, uint16_t value)
{
    ARG_UNUSED(attr);
    switch(value)
    {
        case BT_GATT_CCC_NOTIFY: 
            // Start sending stuff!
            break;

        case BT_GATT_CCC_INDICATE: 
            // Start sending stuff via indications
            break;

        case 0: 
            // Stop sending stuff
            break;
        
        default: 
            printk("Error, CCCD has been set to an invalid value");     
    }
}
                        

/* LED Button Service Declaration and Registration */
BT_GATT_SERVICE_DEFINE(tfMicro_service,
BT_GATT_PRIMARY_SERVICE(BT_UUID_TFMICRO_SERVICE),
BT_GATT_CHARACTERISTIC(BT_UUID_TFMICRO_SERVICE_RX,
			       BT_GATT_CHRC_WRITE | BT_GATT_CHRC_WRITE_WITHOUT_RESP,
			       BT_GATT_PERM_READ | BT_GATT_PERM_WRITE, 
                   NULL, on_receive, NULL),
BT_GATT_CHARACTERISTIC(BT_UUID_TFMICRO_SERVICE_TX,
			       BT_GATT_CHRC_NOTIFY,
			       BT_GATT_PERM_READ,
                   NULL, NULL, NULL),
BT_GATT_CCC(on_cccd_changed,
        BT_GATT_PERM_READ | BT_GATT_PERM_WRITE),
);


/* This function sends a notification to a Client with the provided data,
given that the Client Characteristic Control Descripter has been set to Notify (0x1).
It also calls the on_sent() callback if successful*/
void tfMicro_service_send(struct bt_conn *conn, const uint8_t *data, uint16_t len)
{
    /* 
    The attribute for the TX characteristic is used with bt_gatt_is_subscribed 
    to check whether notification has been enabled by the peer or not.
    Attribute table: 0 = Service, 1 = Primary service, 2 = RX, 3 = TX, 4 = CCC.
    */
    const struct bt_gatt_attr *attr = &tfMicro_service.attrs[3]; 

    struct bt_gatt_notify_params params = 
    {
        .uuid   = BT_UUID_TFMICRO_SERVICE_TX,
        .attr   = attr,
        .data   = data,
        .len    = len,
        .func   = on_sent
    };
    
    // Check whether notifications are enabled or not
    if(bt_gatt_is_subscribed(conn, attr, BT_GATT_CCC_NOTIFY)) 
    {
        // Send the notification
            printk("value in actual sending function: %d", *data);
	    if(bt_gatt_notify_cb(conn, &params))
            
        {
            printk("Error, unable to send notification\n");
        }
    }
    else
    {
        printk("Warning, notification not enabled on the selected attribute\n");
    }
}
```

## src/tensorFlowService.h
```c
#include <zephyr/types.h>
#include <stddef.h>
#include <string.h>
#include <errno.h>
#include <zephyr.h>
#include <soc.h>
#include "common.h"
#include <bluetooth/bluetooth.h>
#include <bluetooth/hci.h>
#include <bluetooth/conn.h>
#include <bluetooth/uuid.h>
#include <bluetooth/gatt.h>

// work queue structure used to send TF lite data and packet counter notification 
//in a interrupt service handler initiated by a timer. 	
struct TfMicroInfo {
    struct k_work work;
    uint8_t *dataPacket;
    uint8_t packetLength;
}; 
extern struct TfMicroInfo my_service ;  // work-queue instance for tflite notifications

#define TFMICRO_SERVICE_UUID 0x1F, 0x35, 0xBD, 0x4B, 0xAE, 0xD0, 0x68, 0x9C,\
				  0xE2, 0x48, 0x81, 0x1D, 0x22, 0x5D, 0x39, 0xDA      

#define RX_CHARACTERISTIC_UUID  0x1F, 0x35, 0xBD, 0x4B, 0xAE, 0xD0, 0x68, 0x9C, \
				 0xE2, 0x48, 0x81, 0x1D, 0x21, 0xC9, 0x39, 0xDA       

#define TX_CHARACTERISTIC_UUID  0x1F, 0x35, 0xBD, 0x4B, 0xAE, 0xD0, 0x68, 0x9C, \
				 0xE2, 0x48, 0x81, 0x1D, 0x22, 0xC9, 0x39, 0xDA       
			                   
/** @brief Callback type for when new data is received. */
typedef void (*data_rx_cb_t)(uint8_t *data, uint8_t length);

/** @brief Callback struct used by the tfMicro_service Service. */
struct tfMicro_service_cb 
{
	/** Data received callback. */
	data_rx_cb_t    data_rx_cb;
};

int tfMicro_service_init(void);

void tfMicro_service_send(struct bt_conn *conn, const uint8_t *data, uint16_t len);

static void tfMicro_notify(struct k_work *);
static void tfMicro_notify(struct k_work *item)
{
    	struct TfMicroInfo* the_device=  ((struct TfMicroInfo *)(((char *)(item)) - offsetof(struct TfMicroInfo, work)));
        
	uint8_t *dataPacket = the_device->dataPacket;
	uint8_t packetLength = the_device->packetLength;
	//printk("data LED =%u, Data counter1=%u, Data counter2=%u,pk=%u\n", dataPacket[0],dataPacket[1],dataPacket[2],packetLength);
	tfMicro_service_send(my_connection, the_device->dataPacket, 3);
}
```
