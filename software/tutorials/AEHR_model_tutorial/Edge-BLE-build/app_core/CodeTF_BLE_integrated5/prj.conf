## CMakeLists.txt
```
# SPDX-License-Identifier: Apache-2.0

cmake_minimum_required(VERSION 3.13.1)
find_package(Zephyr HINTS $ENV{ZEPHYR_BASE})
project(external_lib)

#target_sources(app PRIVATE src/hello_world_test.cc)
target_sources(app PRIVATE src/main.cc)
target_sources(app PRIVATE src/main_functions.cc)
target_sources(app PRIVATE src/constants.cc)
target_sources(app PRIVATE src/output_handler.cc)
target_sources(app PRIVATE src/model.cc)
target_sources(app PRIVATE src/assert.cc)
target_sources(app PRIVATE src/tensorFlowService.cc)
target_sources(app PRIVATE src/aencoder.cc)

zephyr_include_directories(src)

# The external static library that we are linking with does not know
# how to build for this platform so we export all the flags used in
# this zephyr build to the external build system.
#
# Other external build systems may be self-contained enough that they
# do not need any build information from zephyr. Or they may be
# incompatible with certain zephyr options and need them to be
# filtered out.

set(TARGET ${BOARD})
set(TARGET_ARCH cortex-m33)

#!!!ERROR!!!!                  # you need to fix the following path before you run the code
set(TF_SRC_DIR  /home/devan/Documents/ncs/nrf/applications/nrf-tensorflow/tensorflow)
#set(TF_SRC_DIR ${CMAKE_CURRENT_SOURCE_DIR}/../tensorflow)    #Somehow this does not work, and I have no idea why CMAKE does not like the relative path.
set(TF_MAKE_DIR ${TF_SRC_DIR}/tensorflow/lite/micro/tools/make)
set(TF_LIB_DIR ${TF_MAKE_DIR}/gen/${TARGET}_${TARGET_ARCH}/lib)
set(extra_project_flags "-mcpu=${TARGET_ARCH} -mthumb -mno-thumb-interwork -mhard-float -mfpu=fpv5-sp-d16") #I had to remove -DTF_LITE_STATIC_MEMORY to make hello_world run. 

zephyr_get_include_directories_for_lang_as_string(       C C_includes)
zephyr_get_system_include_directories_for_lang_as_string(C C_system_includes)
zephyr_get_compile_definitions_for_lang_as_string(       C C_definitions)
zephyr_get_compile_options_for_lang_as_string(           C C_options)

set(external_project_cflags
  "${C_includes} ${C_definitions} ${optC_optionsions} ${C_system_includes} ${extra_project_flags}"
)

zephyr_get_include_directories_for_lang_as_string(       CXX CXX_includes)
zephyr_get_system_include_directories_for_lang_as_string(CXX CXX_system_includes)
zephyr_get_compile_definitions_for_lang_as_string(       CXX CXX_definitions)
zephyr_get_compile_options_for_lang_as_string(           CXX CXX_options)

set(external_project_cxxflags
  "${CXX_includes} ${CXX_definitions} ${CXX_options} ${CXX_system_includes} ${extra_project_flags}"
)

include(ExternalProject)

# Add an external project to be able download and build the third
# party library. In this case downloading is not necessary as it has
# been committed to the repository.




if(CMAKE_GENERATOR STREQUAL "Unix Makefiles")
# https://www.gnu.org/software/make/manual/html_node/MAKE-Variable.html
set(submake "$(MAKE)")
else() # Obviously no MAKEFLAGS. Let's hope a "make" can be found somewhere.
set(submake "make")
endif()

ExternalProject_Add(
  tf_project                 # Name for custom target
  #PREFIX     ${mylib_build_dir} # Root dir for entire project
  SOURCE_DIR ${TF_SRC_DIR}
  BINARY_DIR ${TF_SRC_DIR} # This particular build system is invoked from the root
  CONFIGURE_COMMAND ""    # Skip configuring the project, e.g. with autoconf
  BUILD_COMMAND
  ${submake} -f tensorflow/lite/micro/tools/make/Makefile
  TARGET=${TARGET}
  TARGET_ARCH=${TARGET_ARCH}
  TARGET_TOOLCHAIN_ROOT=${GNUARMEMB_TOOLCHAIN_PATH}/bin/
  TARGET_TOOLCHAIN_PREFIX=arm-none-eabi-
  #PREFIX=${mylib_build_dir}
  CC=${CMAKE_C_COMPILER}
  CXX=${CMAKE_CXX_COMPILER}
  AR=${CMAKE_AR}
  CCFLAGS=${external_project_cflags} 
  CXXFLAGS=${external_project_cxxflags} 
  microlite
  INSTALL_COMMAND ""      # This particular build system has no install command
  BUILD_BYPRODUCTS ${TF_LIB_DIR}/libtensorflow-microlite.a
  )

# Create a wrapper CMake library that our app can link with
add_library(tf_lib STATIC IMPORTED GLOBAL)

add_dependencies(
  tf_lib
  tf_project
  )
set_target_properties(tf_lib PROPERTIES IMPORTED_LOCATION             ${TF_LIB_DIR}/libtensorflow-microlite.a)
set_target_properties(tf_lib PROPERTIES INTERFACE_INCLUDE_DIRECTORIES "${TF_SRC_DIR};${TF_SRC_DIR}/tensorflow/lite/micro;${TF_MAKE_DIR}/downloads/flatbuffers/include") 

target_link_libraries(app PUBLIC tf_lib)
```

## prj.conf
```kconfig
CONFIG_NCS_SAMPLES_DEFAULTS=y

CONFIG_STDOUT_CONSOLE=y
CONFIG_CPLUSPLUS=y
CONFIG_STD_CPP11=y
CONFIG_NEWLIB_LIBC=y
CONFIG_LIB_CPLUSPLUS=y

#CONFIG_BOARD_ENABLE_CPUNET = y

#FPU config
CONFIG_FPU=y
CONFIG_FP_HARDABI=y
CONFIG_NEWLIB_LIBC_FLOAT_PRINTF=y

CONFIG_BT_CTLR_TX_BUFFER_SIZE=251
CONFIG_BT_CTLR_DATA_LENGTH_MAX=251
CONFIG_BT_RX_BUF_LEN=255

CONFIG_PRINTK=y

# Library for buttons and LEDs
CONFIG_DK_LIBRARY=y

# Enable bluetooth and bonding
CONFIG_BT_SETTINGS=y
CONFIG_BT=y
CONFIG_BT_BONDABLE=y
CONFIG_BT_BONDING_REQUIRED=y
CONFIG_BT_DEBUG_LOG=y
CONFIG_BT_DEVICE_APPEARANCE=833
CONFIG_BT_GAP_PERIPHERAL_PREF_PARAMS=y
CONFIG_BT_MAX_CONN=1
CONFIG_BT_L2CAP_TX_BUF_COUNT=	12
CONFIG_BT_L2CAP_RX_MTU=70
CONFIG_BT_L2CAP_TX_MTU=70

CONFIG_BT_PERIPHERAL=y
CONFIG_BT_PERIPHERAL_PREF_MAX_INT=10
CONFIG_BT_PERIPHERAL_PREF_MIN_INT=6
CONFIG_BT_PERIPHERAL_PREF_TIMEOUT=100
CONFIG_BT_DEVICE_NAME="MotionSenseHRV3"
CONFIG_BT_CTLR_CONN_PARAM_REQ=y
CONFIG_BT_SMP=y

# ENABLE device information service
CONFIG_BT_DIS=y
CONFIG_BT_DIS_FW_REV=y
CONFIG_BT_DIS_FW_REV_STR="1.0"
CONFIG_BT_DIS_HW_REV=y
CONFIG_BT_DIS_HW_REV_STR="1.0"
CONFIG_BT_DIS_MANUF="EETech"
CONFIG_BT_DIS_PNP=n
CONFIG_BT_DIS_MODEL="TensorFlowEn"
CONFIG_BT_DIS_SETTINGS=y
CONFIG_BT_MAX_PAIRED=1

# Enable Battery settings
CONFIG_BT_BAS=y

# SOftdevice configuration
CONFIG_BT_LL_SOFTDEVICE_DEFAULT=y


CONFIG_SETTINGS_RUNTIME=y
CONFIG_SETTINGS=y
CONFIG_SETTINGS_NONE=y
CONFIG_FLASH=y
CONFIG_FLASH_PAGE_LAYOUT=y
CONFIG_FLASH_MAP=y
CONFIG_NVS=y

# timer config
CONFIG_NRFX_TIMER=y
CONFIG_NRFX_TIMER1=y
CONFIG_NRFX_TIMER0=y
CONFIG_NRFX_TIMER2=y

CONFIG_SYSTEM_WORKQUEUE_STACK_SIZE=8192
CONFIG_HEAP_MEM_POOL_SIZE=16384
CONFIG_MAIN_STACK_SIZE=8192
```

## src/main.cc
```c
/* Copyright 2019 The TensorFlow Authors. All Rights Reserved.

Licensed under the Apache License, Version 2.0 (the "License");
you may not use this file except in compliance with the License.
You may obtain a copy of the License at

    http://www.apache.org/licenses/LICENSE-2.0

Unless required by applicable law or agreed to in writing, software
distributed under the License is distributed on an "AS IS" BASIS,
WITHOUT WARRANTIES OR CONDITIONS OF ANY KIND, either express or implied.
See the License for the specific language governing permissions and
limitations under the License.
==============================================================================*/

#include "main_functions.h"
#include <zephyr.h>
#include <zephyr/types.h>
#include <stddef.h>
#include <string.h>
#include <errno.h>
#include <sys/printk.h>
#include <sys/byteorder.h>
#include <drivers/gpio.h>
#include <soc.h>
#include <kernel.h>
#include "common.h"
#include <bluetooth/bluetooth.h>
#include <bluetooth/hci.h>
#include <bluetooth/conn.h>
#include <bluetooth/uuid.h>
#include <bluetooth/gatt.h>

#include "battery_service.h" 
#include <settings/settings.h>
#include "tensorFlowService.h"
#include <nrfx_timer.h>
#include <dk_buttons_and_leds.h>

#define DEVICE_NAME             CONFIG_BT_DEVICE_NAME
#define DEVICE_NAME_LEN         (sizeof(DEVICE_NAME) - 1)

#define DIS_FW_REV_STR		 CONFIG_BT_DIS_FW_REV_STR
#define DIS_FW_REV_STR_LEN 	 (sizeof(DIS_FW_REV_STR))

#define DIS_HW_REV_STR 	 CONFIG_BT_DIS_HW_REV_STR
#define DIS_HW_REV_STR_LEN 	 (sizeof(DIS_HW_REV_STR))

#define DIS_MANUF		 CONFIG_BT_DIS_MANUF
#define DIS_MANUF_LEN 	 	 (sizeof(DIS_MANUF))

#define DIS_MODEL		 CONFIG_BT_DIS_MODEL
#define DIS_MODEL_LEN		 (sizeof(DIS_MODEL))

#define TIMER_MS 20
#define TIMER_PRIORITY 1
#define WORKQUEUE_STACK_SIZE 512
#define WORKQUEUE_PRIORITY 1

#define RUN_STATUS_LED          DK_LED1

K_THREAD_STACK_DEFINE(my_stack_area, WORKQUEUE_STACK_SIZE);
struct batteryInfo my_device;
struct TfMicroInfo my_service;
struct k_work_q my_work_q;

void timer_handler(nrf_timer_event_t, void*);

static K_SEM_DEFINE(ble_init_ok, 0, 1);

uint16_t global_counter;

static bool connectedFlag=false;
static const struct bt_data ad[] = {
	BT_DATA_BYTES(BT_DATA_FLAGS, (BT_LE_AD_GENERAL | BT_LE_AD_NO_BREDR)),
	BT_DATA(BT_DATA_NAME_COMPLETE, DEVICE_NAME, DEVICE_NAME_LEN),
};

static const struct bt_data sd[] = {
	BT_DATA_BYTES(BT_DATA_UUID128_ALL, TFMICRO_SERVICE_UUID),
};

struct bt_conn *my_connection;

static const nrfx_timer_t timer_global = NRFX_TIMER_INSTANCE(1); // Using TIMER1 as TIMER 0 is used by RTOS for ble


static uint8_t ii =0;

// Setting up the device information service
static int settings_runtime_load(void)
{
	settings_runtime_set("bt/dis/model",
			     DIS_MODEL,
			     DIS_MODEL_LEN);
	settings_runtime_set("bt/dis/manuf",
			     DIS_MANUF,
			     DIS_MANUF_LEN);


	settings_runtime_set("bt/dis/fw",
			     DIS_FW_REV_STR,
			     DIS_FW_REV_STR_LEN);
	settings_runtime_set("bt/dis/hw",
			     DIS_HW_REV_STR,
			     DIS_HW_REV_STR_LEN);
	return 0;
}

static void timer_deinit(void)
{
	nrfx_timer_disable(&timer_global);
    	nrfx_timer_uninit(&timer_global);	
}


static void timer_init(void)
{
	uint32_t time_ticks;
	nrfx_err_t          err;
	nrfx_timer_config_t timer_cfg = {
		.frequency = NRF_TIMER_FREQ_1MHz,
		.mode      = NRF_TIMER_MODE_TIMER,
		.bit_width = NRF_TIMER_BIT_WIDTH_24,
		.interrupt_priority = TIMER_PRIORITY,
		.p_context = NULL,
	};  

	err = nrfx_timer_init(&timer_global, &timer_cfg, timer_handler);
	if (err != NRFX_SUCCESS) {
		//printk("nrfx_timer_init failed with: %d\n", err);
	}
	else
		//printk("nrfx_timer_init success with: %d\n", err);
	time_ticks = nrfx_timer_ms_to_ticks(&timer_global, TIMER_MS);
	//printk("time ticks = %d\n", time_ticks);


    	nrfx_timer_extended_compare(&timer_global, NRF_TIMER_CC_CHANNEL0, time_ticks \ 
         , NRF_TIMER_SHORT_COMPARE0_CLEAR_MASK, true);

    	nrfx_timer_enable(&timer_global);
}


static void connected(struct bt_conn *conn, uint8_t err)
{
	struct bt_conn_info info; 
	char addr[BT_ADDR_LE_STR_LEN];

	my_connection = conn;

	if (err) 
	{
		//printk("Connection failed (err %u)\n", err);
		return;
	}
	else if(bt_conn_get_info(conn, &info))
	{
		//printk("Could not parse connection info\n");
	}
	else
	{  // Start the timer and stop advertising and initialize all the modules
		bt_addr_le_to_str(bt_conn_get_dst(conn), addr, sizeof(addr));
		
		printk("Connection established!		\n\
		Connected to: %s					\n\
		Role: %u							\n\
		Connection interval: %u				\n\
		Slave latency: %u					\n\
		Connection supervisory timeout: %u	\n"
		, addr, info.role, info.le.interval, info.le.latency, info.le.timeout);
		
		tfMicro_service_init();

               connectedFlag=true;
		timer_init();
		global_counter = 0;
	}

}

static void disconnected(struct bt_conn *conn, uint8_t reason)
{
	// Stop timer and do all the cleanup
	printk("Disconnected (reason %u)\n", reason);
	timer_deinit();	
	connectedFlag=false;
}

static bool le_param_req(struct bt_conn *conn, struct bt_le_conn_param *param)
{
	
	//If acceptable params, return true, otherwise return false.
	if((param->interval_min > 9) && (param->interval_max > 20))
		return false;
	else
		return true; 
}

static void le_param_updated(struct bt_conn *conn, uint16_t interval, uint16_t latency, uint16_t timeout)
{
	struct bt_conn_info info; 
	char addr[BT_ADDR_LE_STR_LEN];
	
	if(bt_conn_get_info(conn, &info))
	{
		//printk("Could not parse connection info\n");
	}
	else
	{
		bt_addr_le_to_str(bt_conn_get_dst(conn), addr, sizeof(addr));
		
		printk("Connection parameters updated!	\n\
		Connected to: %s						\n\
		New Connection Interval: %u				\n\
		New Slave Latency: %u					\n\
		New Connection Supervisory Timeout: %u	\n"
		, addr, info.le.interval, info.le.latency, info.le.timeout);
                
	}
}

static struct bt_conn_cb conn_callbacks = 
{
	.connected			= connected,
	.disconnected   		= disconnected,
	.le_param_req			= le_param_req,
	.le_param_updated		= le_param_updated
};
static void error(void)
{
	while (true) {
		//printk("Error!\n");
		/* Spin for ever */
		k_sleep(K_MSEC(1000)); //1000ms
	}
}

static void bt_ready(int err)
{
	if (err) 
	{
		printk("BLE init failed with error code %d\n", err);
		return;
	}
	else 	
		printk("BLE init success\n");
	
       
	settings_load();
	 
	settings_runtime_load();

	//Configure connection callbacks
	bt_conn_cb_register(&conn_callbacks);

	//Initalize services
	err = tfMicro_service_init();
        
	if (err) 
	{
		//printk("Failed to init tf Micro (err:%d)\n", err);
		return;
	}

	//Start advertising
	const struct bt_le_adv_param v={ \
        .id = BT_ID_DEFAULT, \
        .sid = 0, \
        .secondary_max_skip = 0, \
        .options = BT_LE_ADV_OPT_CONNECTABLE,\
        .interval_min = BT_GAP_ADV_FAST_INT_MIN_2, \
        .interval_max = BT_GAP_ADV_FAST_INT_MAX_2, \
        .peer = NULL
	};
	
        err = bt_le_adv_start(&v, ad, ARRAY_SIZE(ad),
			      sd, ARRAY_SIZE(sd));
	if (err) {
		//printk("Advertising failed to start (err %d)\n", err);

	}
       else
       //printk("Advertising successfully started\n");

	k_sem_give(&ble_init_ok);
}

// Initialize BLE
static void ble_init(void)
{
	int err;
	


	err = bt_enable(bt_ready);
	if (err) 
	{
		printk("BLE initialization failed\n");
		error(); //Catch error
	}
	
	err = k_sem_take(&ble_init_ok, K_MSEC(500));

	if (!err) 
	{
		printk("Bluetooth initialized\n");
	} else 
	{
		printk("BLE initialization did not complete in time\n");
		error(); //Catch error
	}
	if (err) {
		printk("Bluetooth init failed (err %d)\n", err);
		
	}	
}

// Timer handler that periodically executes commands with a period, 
// which is defined by the macro-variable TIMER_MS

void timer_handler(nrf_timer_event_t event_type, void* p_context)
{
   	uint8_t counts1 = 0;
        float *y;
        float_cast tempVal;
    	uint8_t dataPacket[TFMICRO_DATA_LEN]; // Data packet sent in the TF lite service, contains 3 Bytes 
    	
    switch (event_type)
    {
 
        case NRF_TIMER_EVENT_COMPARE0:
        	global_counter++; // Packet counter 
        	
        	if(global_counter % 100 ==0) { // Executes every 2 seconds
        		ii++;
			////printk("Counter=%d\n",ii);
			my_device.battery_value=ii;
			k_work_submit(&my_device.work); // Schedule a work in the workqueue to notify battery level
        	}
        	
        	if(global_counter % 400 ==0) { // Executes every 8 seconds
        	   	y = loop();
                        for(int i=0;i<16;i++){
                          tempVal.float_val = y[i];
                          dataPacket[counts1++] = tempVal.floatcast[0];
                          dataPacket[counts1++] = tempVal.floatcast[1];
                          dataPacket[counts1++] = tempVal.floatcast[2];
                          dataPacket[counts1++] = tempVal.floatcast[3];             
                        }

        	    	dataPacket[TFMICRO_DATA_LEN-2] = (uint8_t)((global_counter& 0xFF00)>>8);
        	    	dataPacket[TFMICRO_DATA_LEN-1] = (uint8_t)((global_counter& 0x00FF));        	    
		    	my_service.dataPacket = dataPacket;
		    	my_service.packetLength = sizeof(dataPacket);
		    	////printk("global counter=%u,size=%u\n",global_counter,sizeof(dataPacket));
		    	k_work_submit(&my_service.work); // Schedule a work in the workqueue to send TF lite data
        	}    
	        
           break;

        default:
            //Do nothing.
            break;
    }
}



// This is the default main used on systems that have the standard C entry
// point. Other devices (for example FreeRTOS or ESP32) that have different
// requirements for entry code (like an app_main function) should specialize
// this main.cc file in a target-specific subfolder.
int main(int argc, char* argv[]) {
  int blink_status = 0;	
  setup();
  IRQ_CONNECT(TIMER1_IRQn, TIMER_PRIORITY,
			nrfx_timer_1_irq_handler, NULL, 0);
  // Setup the LEDs for blinking while advertising	
  if (dk_leds_init()) {
		//printk("LEDs init failed\n");
		
	}
  // Setup the workqueue thread 
  k_work_q_start(&my_work_q, my_stack_area,
               K_THREAD_STACK_SIZEOF(my_stack_area), WORKQUEUE_PRIORITY);
               
  k_work_init(&my_device.work, bas_notify);             // associate Battery service with a qorkqueue  
  k_work_init(&my_service.work, tfMicro_notify);        // associate tensorflow service with another workqueue     
  
               
  ble_init();	// Initialize BLE
  tfMicro_service_init(); // Initaalize array for TF service
  while (true) {
  
      k_sleep(K_MSEC(1000));
      if(!connectedFlag) // blink LED when the device is not connected and is in advertising state
      	dk_set_led(RUN_STATUS_LED, (++blink_status) % 2);
      else
      	dk_set_led(RUN_STATUS_LED, 0);  // Do not blink if  the device is connected

  }
}
```

## src/aencoder.h
```c
//using .h file for model


#ifndef TENSORFLOW_LITE_MICRO_EXAMPLES_HELLO_WORLD_MODEL_H_
#define TENSORFLOW_LITE_MICRO_EXAMPLES_HELLO_WORLD_MODEL_H_
extern const unsigned char g_modelurd2[];
extern const int g_model_len2;

#endif
```

## src/battery_service.h
```c
#include <zephyr.h>
#include <zephyr/types.h>
#include <sys/printk.h>
#include <device.h>
#include <drivers/pwm.h>
#include <bluetooth/bluetooth.h>
#include <bluetooth/hci.h>
#include <bluetooth/conn.h>
#include <bluetooth/uuid.h>
#include <bluetooth/gatt.h>
#include <kernel.h>
#include <bluetooth/services/lbs.h>
#include <bluetooth/services/bas.h>
#include <settings/settings.h>
#include "common.h"

struct batteryInfo {
    struct k_work work;
    uint8_t battery_value; // user-defined value to pass as input to the work-queue
}; // work queue structure used to execute Batter level notification in a interrupt service handler initiated by a timer. 
extern struct batteryInfo my_device ;  // work-queue instance for batter level

static void bas_notify(struct k_work *);
static void battery_config(void)
{
	// Code for configuring the battery monitor chip to be called in the initalization
}

// Function that periodically extracts the battery level and needs to be called in a timer routine 
static void bas_notify(struct k_work *item)
{
    	struct batteryInfo* the_device=  ((struct batteryInfo *)(((char *)(item)) - offsetof(struct batteryInfo, work)));
        	
    	////printk("Battery value =%u\n", the_device->battery_value);
	uint8_t battery_level = the_device->battery_value;

	bt_bas_set_battery_level(battery_level);
}
```

## src/common.h
```c
// printer.h file
#ifndef COMMON_H_
#define COMMON_H_
typedef union{ 
    float float_val;
    uint8_t floatcast[4];
}float_cast;
 // common.h code goes here
extern struct bt_conn *my_connection; // BLE conection instance used to access the  sofr-device controller
extern uint16_t global_counter;
#endif
```

## src/hello_world_test.cc
```c
/* Copyright 2019 The TensorFlow Authors. All Rights Reserved.

Licensed under the Apache License, Version 2.0 (the "License");
you may not use this file except in compliance with the License.
You may obtain a copy of the License at

    http://www.apache.org/licenses/LICENSE-2.0

Unless required by applicable law or agreed to in writing, software
distributed under the License is distributed on an "AS IS" BASIS,
WITHOUT WARRANTIES OR CONDITIONS OF ANY KIND, either express or implied.
See the License for the specific language governing permissions and
limitations under the License.
==============================================================================*/

#include "tensorflow/lite/micro/all_ops_resolver.h"
#include "model.h"
#include "tensorflow/lite/micro/micro_error_reporter.h"
#include "tensorflow/lite/micro/micro_interpreter.h"
#include "tensorflow/lite/micro/testing/micro_test.h"
#include "tensorflow/lite/schema/schema_generated.h"
#include "tensorflow/lite/version.h"
#include <zephyr.h>

TF_LITE_MICRO_TESTS_BEGIN

TF_LITE_MICRO_TEST(LoadModelAndPerformInference) {
  // Set up logging
  tflite::MicroErrorReporter micro_error_reporter;
  tflite::ErrorReporter* error_reporter = &micro_error_reporter;

  // Map the model into a usable data structure. This doesn't involve any
  // copying or parsing, it's a very lightweight operation.
  //printk("start her\n");
  const tflite::Model* model = ::tflite::GetModel(g_modelurd);
  if (model->version() != TFLITE_SCHEMA_VERSION) {
    TF_LITE_REPORT_ERROR(error_reporter,
                         "Model provided is schema version %d not equal "
                         "to supported version %d.\n",
                         model->version(), TFLITE_SCHEMA_VERSION);
  }

  // This pulls in all the operation implementations we need
  tflite::AllOpsResolver resolver;

  // Create an area of memory to use for input, output, and intermediate arrays.

  // Minimum arena size, at the time of writing. After allocating tensors
  // you can retrieve this value by invoking interpreter.arena_used_bytes().
  const int model_arena_size = 2512;
  /* Extra headroom for model + alignment + future interpreter changes */
  const int extra_arena_size = 570 + 16 + 100+4;
  const int tensor_arena_size = model_arena_size + extra_arena_size;
  uint8_t tensor_arena[tensor_arena_size];

  // Build an interpreter to run the model with
  tflite::MicroInterpreter interpreter(model, resolver, tensor_arena,
                                       tensor_arena_size, error_reporter);
  // Allocate memory from the tensor_arena for the model's tensors
  TF_LITE_MICRO_EXPECT_EQ(interpreter.AllocateTensors(), kTfLiteOk);

  // Alert for substantial increase in arena size usage.
  TF_LITE_MICRO_EXPECT_LE(interpreter.arena_used_bytes(),
                          model_arena_size + 100);
  // Obtain a pointer to the model's input tensor
  TfLiteTensor* input = interpreter.input(0);

  // Make sure the input has the properties we expect
  TF_LITE_MICRO_EXPECT_NE(nullptr, input);
  // The property "dims" tells us the tensor's shape. It has one element for
  // each dimension. Our input is a 2D tensor containing 1 element, so "dims"
  // should have size 2.
  TF_LITE_MICRO_EXPECT_EQ(2, input->dims->size);
  // The value of each element gives the length of the corresponding tensor.
  // We should expect two single element tensors (one is contained within the
  // other).
  TF_LITE_MICRO_EXPECT_EQ(1, input->dims->data[0]);
  TF_LITE_MICRO_EXPECT_EQ(1, input->dims->data[1]);
  // The input is a 32 bit floating point value
  TF_LITE_MICRO_EXPECT_EQ(kTfLiteFloat32, input->type);

  // Provide an input value
  input->data.f[0] = 0.;

  // Run the model on this input and check that it succeeds
  TfLiteStatus invoke_status = interpreter.Invoke();
  TF_LITE_MICRO_EXPECT_EQ(kTfLiteOk, invoke_status);

  // Obtain a pointer to the output tensor and make sure it has the
  // properties we expect. It should be the same as the input tensor.
  TfLiteTensor* output = interpreter.output(0);
  TF_LITE_MICRO_EXPECT_EQ(2, output->dims->size);
  TF_LITE_MICRO_EXPECT_EQ(1, input->dims->data[0]);
  TF_LITE_MICRO_EXPECT_EQ(1, input->dims->data[1]);
  TF_LITE_MICRO_EXPECT_EQ(kTfLiteFloat32, output->type);

  // Obtain the output value from the tensor
  float value = output->data.f[0];
  // Check that the output value is within 0.05 of the expected value
  TF_LITE_MICRO_EXPECT_NEAR(0., value, 0.05);

  // Run inference on several more values and confirm the expected outputs
  input->data.f[0] = 1.;
  invoke_status = interpreter.Invoke();
  TF_LITE_MICRO_EXPECT_EQ(kTfLiteOk, invoke_status);

  value = output->data.f[0];
  TF_LITE_MICRO_EXPECT_NEAR(0.841, value, 0.05);

  input->data.f[0] = 3.;
  invoke_status = interpreter.Invoke();
  TF_LITE_MICRO_EXPECT_EQ(kTfLiteOk, invoke_status);

  value = output->data.f[0];
  TF_LITE_MICRO_EXPECT_NEAR(0.141, value, 0.05);

  input->data.f[0] = 5.;
  invoke_status = interpreter.Invoke();
  TF_LITE_MICRO_EXPECT_EQ(kTfLiteOk, invoke_status);

  value = output->data.f[0];
  TF_LITE_MICRO_EXPECT_NEAR(-0.959, value, 0.05);
  while(1){
    k_sleep(K_SECONDS(1));
  }
}

TF_LITE_MICRO_TESTS_END
```

## src/main_functions.cc
```c
/* Copyright 2020 The TensorFlow Authors. All Rights Reserved.

Licensed under the Apache License, Version 2.0 (the "License");
you may not use this file except in compliance with the License.
You may obtain a copy of the License at

    http://www.apache.org/licenses/LICENSE-2.0

Unless required by applicable law or agreed to in writing, software
distributed under the License is distributed on an "AS IS" BASIS,
WITHOUT WARRANTIES OR CONDITIONS OF ANY KIND, either express or implied.
See the License for the specific language governing permissions and
limitations under the License.
==============================================================================*/

#include "main_functions.h"
#include "sample_test.h"

#define USENEWMODEL 1

#include "tensorflow/lite/micro/all_ops_resolver.h"
#include "constants.h"
#include "output_handler.h"
#include "tensorflow/lite/micro/micro_error_reporter.h"
#include "tensorflow/lite/micro/micro_interpreter.h"
#include "tensorflow/lite/schema/schema_generated.h"
#include "tensorflow/lite/version.h"


#if USENEWMODEL == 1
#include "model.h"
#define MODEL_LEN 2500
#define MODEL_HEADROOM 200
#define g_modelurd2 0

#else
#include "aencoder.h"
#define MODEL_LEN 123904
#define MODEL_HEADROOM 200000
#define g_modelurd 0
#endif


#include <zephyr.h>

// Globals, used for compatibility with Arduino-style sketches.
namespace
{
tflite::ErrorReporter *error_reporter = nullptr;
const tflite::Model *model = nullptr;
tflite::MicroInterpreter *interpreter = nullptr;
TfLiteTensor *input = nullptr;
TfLiteTensor *output = nullptr;
int inference_count = 0;

// Create an area of memory to use for input, output, and intermediate arrays.
// Minimum arena size, at the time of writing. After allocating tensors
// you can retrieve this value by invoking interpreter.arena_used_bytes().
const int kModelArenaSize = MODEL_LEN;
// Extra headroom for model + alignment + future interpreter changes.
const int kExtraArenaSize = MODEL_HEADROOM;
const int kTensorArenaSize = kModelArenaSize + kExtraArenaSize;
static uint8_t tensor_arena[kTensorArenaSize] ; 
} // namespace

// The name of this function is important for Arduino compatibility.
void setup()
{
	outputInit();

	// Set up logging. Google style is to avoid globals or statics because of
	// lifetime uncertainty, but since this has a trivial destructor it's okay.
	// NOLINTNEXTLINE(runtime-global-variables)

	static tflite::MicroErrorReporter micro_error_reporter;
	error_reporter = &micro_error_reporter;

	// Map the model into a usable data structure. This doesn't involve any
	// copying or parsing, it's a very lightweight operation.
	#if USENEWMODEL == 1
            model = tflite::GetModel(g_modelurd2);
            
        #else
            model = tflite::GetModel(g_modelurd);
        #endif    

	if (model->version() != TFLITE_SCHEMA_VERSION) {
		TF_LITE_REPORT_ERROR(
			error_reporter,
			"Model provided is schema version %d not equal "
			"to supported version %d.",
			model->version(), TFLITE_SCHEMA_VERSION);
		return;
	}

	// This pulls in all the operation implementations we need.
	// NOLINTNEXTLINE(runtime-global-variables)
	static tflite::AllOpsResolver resolver;

	// Build an interpreter to run the model with.
	static tflite::MicroInterpreter static_interpreter(model, resolver,
							   tensor_arena,
							   kTensorArenaSize,
							   error_reporter);
	interpreter = &static_interpreter;

	// Allocate memory from the tensor_arena for the model's tensors.
	TfLiteStatus allocate_status = interpreter->AllocateTensors();

	if (allocate_status != kTfLiteOk) {

		return;
	}

	// Obtain pointers to the model's input and output tensors.
	input = interpreter->input(0);
	output = interpreter->output(0);

	// Keep track of how many inferences we have performed.
	inference_count = 0;
}

// The name of this function is important for Arduino compatibility.
float * loop()
{
float y[16];
uint32_t start_time;
uint32_t stop_time;
uint32_t cycles_spent;
uint32_t nanoseconds_spent;

/* capture initial time stamp */
start_time = k_cycle_get_32();

        //first set our output array
        static float arr_result[16];

	//get a ppg sample to feed into the model. We this is an 8 second
	// sample for a total of 400 values, whitch should be placed in our input.
	

        TfLiteIntArray* n_dims = input->dims;
	// Place the calculated ppg value in the model's input tensor

        /*.f is not actually the floating point cast, it is a a structure member
        since it is a union, each of the . data types represents any possible input format.
        This could mean you could represent your input in uint8, or float32. We use
        float32 since that is the default specification for inputs and outputs in 
        tensorflow lite models.
        */

	float xval = 0;
        //get ready to load the test ppg data into the input tensor
        for (int i = 0; i<400; i++){
                xval = sample_data[i];
                input->data.f[i] = sample_data[i];
        }
        //just using this test variable to inspect whether everything checks out
        float test_bounds = input->data.f[399];



	//Now we run inference, and report any error
	TfLiteStatus invoke_status = interpreter->Invoke();
	if (invoke_status != kTfLiteOk) {
		TF_LITE_REPORT_ERROR(error_reporter,"Invoke failed");
				    
		return NULL;
	}

	// Read the predicted y value from the model's output tensor
	

	// Output the results. A custom HandleOutput function can be implemented
	// for each supported hardware target.

        
        for (int i = 0; i < 16; i++){
            arr_result[i] = output->data.f[i];
            }
        y[0] = output->data.f[0];
        y[1] = output->data.f[1];
        y[2] = output->data.f[2];
        y[3] = output->data.f[3];
        y[4] = output->data.f[4];
        y[5] = output->data.f[5];
        y[6] = output->data.f[6];
        y[7] = output->data.f[7];
        y[8]  = output->data.f[8];
        y[9] = output->data.f[9];
        y[10] = output->data.f[10];
        y[11] = output->data.f[11];
        y[12] = output->data.f[12];
        y[13] = output->data.f[13];
        y[14] = output->data.f[14];
        y[15] = output->data.f[15];

	// Increment the inference_counter, and reset it if we have reached
	// the total number per cycle
	inference_count += 1;
        if (inference_count > 2000){
            inference_count = 0;
                       }
        int te = inference_count;
        stop_time = k_cycle_get_32();

/* compute how long the work took (assumes no counter rollover) */
cycles_spent = stop_time - start_time;
nanoseconds_spent = SYS_CLOCK_HW_CYCLES_TO_NS(cycles_spent);
        printk("time spent, %d\n", nanoseconds_spent);
        //we return something random here since this is just to check to make sure ble is working.
	return y;	
}
```

## src/main_functions.h
```c
/* Copyright 2019 The TensorFlow Authors. All Rights Reserved.

Licensed under the Apache License, Version 2.0 (the "License");
you may not use this file except in compliance with the License.
You may obtain a copy of the License at

    http://www.apache.org/licenses/LICENSE-2.0

Unless required by applicable law or agreed to in writing, software
distributed under the License is distributed on an "AS IS" BASIS,
WITHOUT WARRANTIES OR CONDITIONS OF ANY KIND, either express or implied.
See the License for the specific language governing permissions and
limitations under the License.
==============================================================================*/

#ifndef TENSORFLOW_LITE_MICRO_EXAMPLES_HELLO_WORLD_MAIN_FUNCTIONS_H_
#define TENSORFLOW_LITE_MICRO_EXAMPLES_HELLO_WORLD_MAIN_FUNCTIONS_H_

// Expose a C friendly interface for main functions.
#ifdef __cplusplus
extern "C" {
#endif

// Initializes all data needed for the example. The name is important, and needs
// to be setup() for Arduino compatibility.
void setup();

// Runs one iteration of data gathering and inference. This should be called
// repeatedly from the application code. The name needs to be loop() for Arduino
// compatibility.
float* loop();

#ifdef __cplusplus
}
#endif

#endif  // TENSORFLOW_LITE_MICRO_EXAMPLES_HELLO_WORLD_MAIN_FUNCTIONS_H_
```

## src/main_functions2.cc
```c
/* Copyright 2020 The TensorFlow Authors. All Rights Reserved.

Licensed under the Apache License, Version 2.0 (the "License");
you may not use this file except in compliance with the License.
You may obtain a copy of the License at

    http://www.apache.org/licenses/LICENSE-2.0

Unless required by applicable law or agreed to in writing, software
distributed under the License is distributed on an "AS IS" BASIS,
WITHOUT WARRANTIES OR CONDITIONS OF ANY KIND, either express or implied.
See the License for the specific language governing permissions and
limitations under the License.
==============================================================================*/

//define target model to use
#define USENEWMODEL 0

#include "main_functions.h"

#include "tensorflow/lite/micro/all_ops_resolver.h"
#include "constants.h"

#include "output_handler.h"
#include "tensorflow/lite/micro/micro_error_reporter.h"
#include "tensorflow/lite/micro/micro_interpreter.h"
#include "tensorflow/lite/schema/schema_generated.h"
#include "tensorflow/lite/version.h"

#include "sample_test.cc"


#if USENEWMODEL == 1
#include "aencoder.h"
#define MODEL_LEN 123904
#define MODEL_HEADROOM 200000
#define g_modelurd 0
#else
#include "model.h"
#define MODEL_LEN 2512
#define MODEL_HEADROOM 676
#define g_modelurd2 0
#endif

#include <zephyr.h>

// Globals, used for compatibility with Arduino-style sketches.
namespace
{
tflite::ErrorReporter *error_reporter = nullptr;
const tflite::Model *model = nullptr;
tflite::MicroInterpreter *interpreter = nullptr;
TfLiteTensor *input = nullptr;
TfLiteTensor *output = nullptr;
int inference_count = 0;

// Create an area of memory to use for input, output, and intermediate arrays.
// Minimum arena size, at the time of writing. After allocating tensors
// you can retrieve this value by invoking interpreter.arena_used_bytes().
const int kModelArenaSize = MODEL_LEN;
// Extra headroom for model + alignment + future interpreter changes.
const int kExtraArenaSize = MODEL_HEADROOM;
const int kTensorArenaSize = kModelArenaSize + kExtraArenaSize;
static uint8_t tensor_arena[kTensorArenaSize];
} // namespace

// The name of this function is important for Arduino compatibility.
void setup()
{
	outputInit();

	// Set up logging. Google style is to avoid globals or statics because of
	// lifetime uncertainty, but since this has a trivial destructor it's okay.
	// NOLINTNEXTLINE(runtime-global-variables)

	static tflite::MicroErrorReporter micro_error_reporter;
	error_reporter = &micro_error_reporter;

	// Map the model into a usable data structure. This doesn't involve any
	// copying or parsing, it's a very lightweight operation.
        if (USENEWMODEL){
            model = tflite::GetModel(g_modelurd2);
            }
        else {
            model = tflite::GetModel(g_modelurd);
            }


	if (model->version() != TFLITE_SCHEMA_VERSION) {
		TF_LITE_REPORT_ERROR(
			error_reporter,
			"Model provided is schema version %d not equal "
			"to supported version %d.",
			model->version(), TFLITE_SCHEMA_VERSION);
		return;
	}

/* This pulls in all the operation implementations we need. However we might change
       this later on as we only really need dense and convulution functions for the autoencoder
       But, if we want models to be able to be swapped out during runtime, it should stay this way.*/

	// NOLINTNEXTLINE(runtime-global-variables)
	static tflite::AllOpsResolver resolver;

	// Build an interpreter to run the model with.
	static tflite::MicroInterpreter static_interpreter(model, resolver,
							   tensor_arena,
							   kTensorArenaSize,
							   error_reporter);
	interpreter = &static_interpreter;

	// Allocate memory from the tensor_arena for the model's tensors.
	TfLiteStatus allocate_status = interpreter->AllocateTensors();

	if (allocate_status != kTfLiteOk) {
		TF_LITE_REPORT_ERROR(error_reporter,
				     "AllocateTensors() failed");

		return;
	}

	// Obtain pointers to the model's input and output tensors.
	input = interpreter->input(0);
	output = interpreter->output(0);

	// Keep track of how many inferences we have performed.
	inference_count = 0;
}

// The name of this function is important for Arduino compatibility.
unsigned int loop()
{
        //first set our output array
        static float arr_result[16];

	//get a ppg sample to feed into the model. We this is an 8 second
	// sample for a total of 400 values, whitch should be placed in our input.
	

        TfLiteIntArray* n_dims = input->dims;
	// Place the calculated ppg value in the model's input tensor

        /*.f is not actually the floating point cast, it is a a structure member
        since it is a union, each of the . data types represents any possible input format.
        This could mean you could represent your input in uint8, or float32. We use
        float32 since that is the default specification for inputs and outputs in 
        tensorflow lite models.
        */

	float xval = 0;
        //get ready to load the test ppg data into the input tensor
        for (int i = 0; i<400; i++){
                xval = sample_data[i];
                input->data.f[i] = sample_data[i];
        }
        //just using this test variable to inspect whether everything checks out
        float test_bounds = input->data.f[399];



	//Now we run inference, and report any error
	TfLiteStatus invoke_status = interpreter->Invoke();
	if (invoke_status != kTfLiteOk) {
		TF_LITE_REPORT_ERROR(error_reporter,"Invoke failed");
				    
		return NULL;
	}

	// Read the predicted y value from the model's output tensor
	

	// Output the results. A custom HandleOutput function can be implemented
	// for each supported hardware target.

        
        for (int i = 0; i < 16; i++){
            arr_result[i] = output->data.f[i];
            }
        float y_1 = output->data.f[0];
        float y_2 = output->data.f[1];
        float y_16 = output->data.f[15];
	// Increment the inference_counter, and reset it if we have reached
	// the total number per cycle
	inference_count += 1;
        if (inference_count > 2000){
            inference_count = 0;
                       }
        int te = inference_count;
        //printk("value returned, %d", te);
        //we return something random here since this is just to check to make sure ble is working.
	return te;	
}
  
```

## src/main_functions2.h
```c
/* Copyright 2019 The TensorFlow Authors. All Rights Reserved.

Licensed under the Apache License, Version 2.0 (the "License");
you may not use this file except in compliance with the License.
You may obtain a copy of the License at

    http://www.apache.org/licenses/LICENSE-2.0

Unless required by applicable law or agreed to in writing, software
distributed under the License is distributed on an "AS IS" BASIS,
WITHOUT WARRANTIES OR CONDITIONS OF ANY KIND, either express or implied.
See the License for the specific language governing permissions and
limitations under the License.
==============================================================================*/

#ifndef TENSORFLOW_LITE_MICRO_EXAMPLES_HELLO_WORLD_MAIN_FUNCTIONS_H_
#define TENSORFLOW_LITE_MICRO_EXAMPLES_HELLO_WORLD_MAIN_FUNCTIONS_H_

// Expose a C friendly interface for main functions.
#ifdef __cplusplus
extern "C" {
#endif

// Initializes all data needed for the example. The name is important, and needs
// to be setup() for Arduino compatibility.
void setup();

// Runs one iteration of data gathering and inference. This should be called
// repeatedly from the application code. The name needs to be loop() for Arduino
// compatibility.
unsigned int loop();

#ifdef __cplusplus
}
#endif

#endif  // TENSORFLOW_LITE_MICRO_EXAMPLES_HELLO_WORLD_MAIN_FUNCTIONS_H_
```

## src/main_functions3.cc
```c
/* Copyright 2020 The TensorFlow Authors. All Rights Reserved.

Licensed under the Apache License, Version 2.0 (the "License");
you may not use this file except in compliance with the License.
You may obtain a copy of the License at

    http://www.apache.org/licenses/LICENSE-2.0

Unless required by applicable law or agreed to in writing, software
distributed under the License is distributed on an "AS IS" BASIS,
WITHOUT WARRANTIES OR CONDITIONS OF ANY KIND, either express or implied.
See the License for the specific language governing permissions and
limitations under the License.
==============================================================================*/

#define USENEWMODEL 0

#include "main_functions.h"
#include "tensorflow/lite/micro/all_ops_resolver.h"
#include "constants.h"
#include "output_handler.h"
#include "tensorflow/lite/micro/micro_error_reporter.h"
#include "tensorflow/lite/micro/micro_interpreter.h"
#include "tensorflow/lite/schema/schema_generated.h"
#include "tensorflow/lite/version.h"

#if USENEWMODEL == 1
#include "aencoder.h"
#define MODEL_LEN 123904
#define MODEL_HEADROOM 200000
#define g_modelurd 0
#else
#include "model.h"
#define MODEL_LEN 2512
#define MODEL_HEADROOM 676
#define g_modelurd2 0
#endif

#include <zephyr.h>

// Globals, used for compatibility with Arduino-style sketches.
namespace
{
tflite::ErrorReporter *error_reporter = nullptr;
const tflite::Model *model = nullptr;
tflite::MicroInterpreter *interpreter = nullptr;
TfLiteTensor *input = nullptr;
TfLiteTensor *output = nullptr;
int inference_count = 0;

// Create an area of memory to use for input, output, and intermediate arrays.
// Minimum arena size, at the time of writing. After allocating tensors
// you can retrieve this value by invoking interpreter.arena_used_bytes().
const int kModelArenaSize = MODEL_LEN;
// Extra headroom for model + alignment + future interpreter changes.
const int kExtraArenaSize = MODEL_HEADROOM;
const int kTensorArenaSize = kModelArenaSize + kExtraArenaSize;
static uint8_t tensor_arena[kTensorArenaSize];
} // namespace

// The name of this function is important for Arduino compatibility.
void setup()
{
	outputInit();

	// Set up logging. Google style is to avoid globals or statics because of
	// lifetime uncertainty, but since this has a trivial destructor it's okay.
	// NOLINTNEXTLINE(runtime-global-variables)

	static tflite::MicroErrorReporter micro_error_reporter;
	error_reporter = &micro_error_reporter;

	// Map the model into a usable data structure. This doesn't involve any
	// copying or parsing, it's a very lightweight operation.
	if (USENEWMODEL){
            model = tflite::GetModel(g_modelurd2);
            }
        else {
            model = tflite::GetModel(g_modelurd);
            }

	if (model->version() != TFLITE_SCHEMA_VERSION) {
		TF_LITE_REPORT_ERROR(
			error_reporter,
			"Model provided is schema version %d not equal "
			"to supported version %d.",
			model->version(), TFLITE_SCHEMA_VERSION);
		return;
	}

	// This pulls in all the operation implementations we need.
	// NOLINTNEXTLINE(runtime-global-variables)
	static tflite::AllOpsResolver resolver;

	// Build an interpreter to run the model with.
	static tflite::MicroInterpreter static_interpreter(model, resolver,
							   tensor_arena,
							   kTensorArenaSize,
							   error_reporter);
	interpreter = &static_interpreter;

	// Allocate memory from the tensor_arena for the model's tensors.
	TfLiteStatus allocate_status = interpreter->AllocateTensors();

	if (allocate_status != kTfLiteOk) {
		TF_LITE_REPORT_ERROR(error_reporter,
				     "AllocateTensors() failed");

		return;
	}

	// Obtain pointers to the model's input and output tensors.
	input = interpreter->input(0);
	output = interpreter->output(0);

	// Keep track of how many inferences we have performed.
	inference_count = 0;
}

// The name of this function is important for Arduino compatibility.
unsigned int loop()
{
	// Calculate an x value to feed into the model. We compare the current
	// inference_count to the number of inferences per cycle to determine
	// our position within the range of possible x values the model was
	// trained on, and use this to calculate a value.
	float position = static_cast<float>(inference_count) /
			 static_cast<float>(kInferencesPerCycle);
	unsigned int output_tf;
	float x_val = position * kXrange;

	// Place our calculated x value in the model's input tensor
	input->data.f[0] = x_val;
	// Run inference, and report any error
	TfLiteStatus invoke_status = interpreter->Invoke();
	if (invoke_status != kTfLiteOk) {
		TF_LITE_REPORT_ERROR(error_reporter,
				     "Invoke failed on x_val: %f\n",
				     static_cast<double>(x_val));
		return NULL;
	}

	// Read the predicted y value from the model's output tensor
	float y_val = output->data.f[0];

	// Output the results. A custom HandleOutput function can be implemented
	// for each supported hardware target.
	output_tf = HandleOutput(error_reporter, x_val, y_val);


	// Increment the inference_counter, and reset it if we have reached
	// the total number per cycle
	inference_count += 1;
	if (inference_count >= kInferencesPerCycle){
		inference_count = 0;
        }
        int ren = 9;
        //we just have a random test variable here to see if bluetooth is sending
	return output_tf;	
}
  
```

## src/sample_test.cc
```c
const float sample_data[400] = {-1.04691969,-0.94846849,-0.78984398,-0.69336705,-0.64262755,-0.50070642
,-0.14154479,0.4110199,0.95732974,1.23913916,1.11024263,0.62887148
,0.01045522,-0.50818309,-0.78821298,-0.82471132,-0.70681982,-0.54890409
,-0.42837179,-0.34545464,-0.2209481,0.05045093,0.5049396,1.0370595
,1.42400804,1.45452755,1.07520549,0.43752714,-0.19552763,-0.60944331
,-0.74341583,-0.67870654,-0.5472451,-0.4425767,-0.38206316,-0.31552936
,-0.15981123,0.14695728,0.58107406,1.0004723,1.19442397,1.0116531
,0.48000966,-0.18810868,-0.72505488,-0.97427501,-0.96239443,-0.83268111
,-0.71524275,-0.64509568,-0.57067068,-0.41077603,-0.10459947,0.35499762
,0.89054201,1.32960712,1.46303507,1.17492593,0.5548645,-0.12457582
,-0.5800201,-0.70676836,-0.61938905,-0.51161047,-0.47744302,-0.46521937
,-0.38758741,-0.24451527,-0.11536328,-0.03847868,0.06437623,0.30835643
,0.68388417,0.99775553,1.00731654,0.63332781,0.04441657,-0.47152556
,-0.72526713,-0.7334145,-0.64026246,-0.56209218,-0.51041153,-0.43632964
,-0.30737054,-0.12350095,0.1178317,0.42811455,0.77519382,1.03980382
,1.06421589,0.77685853,0.27622949,-0.22096003,-0.53191393,-0.62408213
,-0.59735271,-0.56699336,-0.56829597,-0.56003397,-0.49216798,-0.35037487
,-0.14217514,0.13008521,0.45514837,0.77049297,0.95808456,0.9126014
,0.63166697,0.23869872,-0.09445299,-0.26261248,-0.28278851,-0.25136691
,-0.25245337,-0.29805887,-0.33636476,-0.30144811,-0.15800159,0.07981337
,0.34914858,0.55330674,0.59662333,0.43647196,0.12211136,-0.21886924
,-0.45184206,-0.5173369,-0.45963672,-0.37786448,-0.34043574,-0.33326726
,-0.28056955,-0.11568753,0.15695899,0.45326783,0.65412433,0.66901964
,0.48106303,0.15428802,-0.19568206,-0.4535951,-0.55670147,-0.52040912
,-0.41902474,-0.32853556,-0.2682035,-0.18614467,-0.00606192,0.29615944
,0.64689292,0.90257481,0.9366367,0.72232432,0.34932694,-0.03591054
,-0.31760355,-0.46145894,-0.50210747,-0.49341352,-0.46848467,-0.43200432
,-0.37110549,-0.26228885,-0.07452584,0.2121238,0.56820411,0.88922161
,1.02612617,0.87388874,0.45753399,-0.06282583,-0.48801261,-0.70748617
,-0.75447684,-0.74479528,-0.759707,-0.78149195,-0.73396068,-0.5744392
,-0.33574461,-0.07641281,0.19739454,0.53799869,0.96707305,1.38226711
,1.57682293,1.3864615,0.84149572,0.1751982,-0.3370268,-0.57251858
,-0.61816898,-0.64692013,-0.74257106,-0.84200942,-0.83431245,-0.69297883
,-0.49286897,-0.30143002,-0.08186079,0.26262911,0.73617828,1.16061416
,1.27452773,0.95234947,0.33504773,-0.26453875,-0.60093218,-0.65851902
,-0.59872888,-0.57009745,-0.58201489,-0.55016564,-0.42712984,-0.25293839
,-0.07622643,0.13684905,0.46991149,0.91695038,1.29935887,1.36426651
,0.99658076,0.34074977,-0.29588062,-0.67255412,-0.76563846,-0.71872712
,-0.67300427,-0.65639165,-0.61488385,-0.50705204,-0.33759728,-0.11109932
,0.2008146,0.6071209,1.01295785,1.22419697,1.07860035,0.59388287
,-0.01714574,-0.49232302,-0.69791952,-0.68437362,-0.59297208,-0.52423984
,-0.48713787,-0.43991838,-0.34383893,-0.17259152,0.09678099,0.45862688
,0.82906094,1.04594546,0.96127448,0.56435442,0.01767638,-0.44414759
,-0.67194898,-0.68111118,-0.59565285,-0.52681506,-0.4996067,-0.47052659
,-0.38609592,-0.21561676,0.04922388,0.3888737,0.73067728,0.94531216
,0.90748233,0.59400221,0.130637,-0.2732945,-0.46215337,-0.43014295
,-0.29767489,-0.19717732,-0.17195702,-0.16543082,-0.08908268,0.10175442
,0.37870322,0.65751669,0.83275537,0.81434587,0.56755096,0.1466371
,-0.30915454,-0.63815948,-0.74888008,-0.6736798,-0.53402676,-0.43970014
,-0.40369172,-0.3429826,-0.16178998,0.15450558,0.5104875,0.75503733
,0.77313865,0.55032619,0.17495063,-0.21209863,-0.4854404,-0.58707777
,-0.54175434,-0.43094303,-0.33754903,-0.29077257,-0.24718976,-0.12686425
,0.11435982,0.42766868,0.67816498,0.72207445,0.50589902,0.11569005
,-0.26512258,-0.46584761,-0.43152995,-0.24634839,-0.06190956,0.01567048
,-0.00335243,-0.01384812,0.08977393,0.3193703,0.57022477,0.68649861
,0.56734704,0.23818659,-0.16184981,-0.46583515,-0.57821633,-0.5202266
,-0.39349942,-0.2915453,-0.22598,-0.12448321,0.09534411,0.43211577
,0.76443134,0.91148813,0.75481212,0.33132418,-0.17776954,-0.56021607
,-0.70504217,-0.65432752,-0.53927732,-0.45868772,-0.40172287,-0.27539516
,-0.00771189,0.36339704,0.6895333,0.80050688,0.61546495,0.19814386
,-0.27763366,-0.62544563,-0.74425245,-0.65916111,-0.48350676,-0.32834093
,-0.22048222,-0.08967598,0.15966722,0.54290243,0.94288785,1.16524573
,1.06921816,0.67331947,0.1489446,-0.29375787,-0.53469787,-0.58873298
,-0.54812747,-0.49078734,-0.43514024,-0.35975281,-0.24166494,-0.06799855
,0.17233167,0.47777871,0.79612942,1.00640237,0.97096236,0.63939555
,0.11469216,-0.39428078,-0.71003393,-0.79929933,-0.76400033,-0.72653151
,-0.72293897,-0.69948628,-0.59601522,-0.4140999};
```
